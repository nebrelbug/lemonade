#include "Relay.h"
#include <FastLED.h>
#define NUM_LEDS 60
#define DATA_PIN 6

const int buttonPin = 2;     // the number of the pushbutton pin
const int ledPin =  13;      // the number of the LED pin
int buttonState = 0;         // variable for reading the pushbutton status
int relay = 0               // indicates whether relay is on or off           

CRGB leds[NUM_LEDS];
Relay light(2, false); // constructor receives (pin, isNormallyOpen) true = Normally Open, false = Normally Closed

void setup() {
	light.begin(); // inicializes the pin
	// initialize the LED pin as an output:
  pinMode(ledPin, OUTPUT);
  // initialize the pushbutton pin as an input:
  pinMode(buttonPin, INPUT);
  FastLED.addLeds<NEOPIXEL, DATA_PIN>(leds, NUM_LEDS);
}

void loop() {
	bool isLightOn = light.getState(); //returns a bool, true = on, false = off
	// read the state of the pushbutton value:
  buttonState = digitalRead(buttonPin);

  // check if the pushbutton is pressed. If it is, the buttonState is HIGH:
  if ((buttonState == HIGH) && (relay == 0)){
    light.turnOff(); //turns relay off
    int relay == 1
  } 
  if ((buttonState == HIGH) && (relay == 1)){
    light.turnOn();  //turns relay on
    int relay == 0
  }
  for (int dot = 0; dot < NUM_LEDS; dot++) {
    leds[dot] = CRGB::Red;
    FastLED.show();
    // clear this led for the next time around the loop
    leds[dot] = CRGB::Red;
    delay(30);
  }
    for (int dot = 0; dot < NUM_LEDS; dot++) {
    leds[dot] = CRGB::Green;
    FastLED.show();
    // clear this led for the next time around the loop
    leds[dot] = CRGB::Green;
    delay(30);
  }
}


